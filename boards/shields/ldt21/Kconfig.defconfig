## boards/shields/ldt21/Kconfig.defconfig
```kconfig
if SHIELD_LDT21_LEFT

config ZMK_KEYBOARD_NAME
    default "ldt21"

config ZMK_SPLIT_ROLE_CENTRAL
    default y

endif

if SHIELD_LDT21_LEFT || SHIELD_LDT21_RIGHT

    config ZMK_SPLIT
        default y

endif
```

## boards/shields/ldt21/Kconfig.shield
```kconfig
config SHIELD_LDT21_LEFT
    def_bool $(shields_list_contains,ldt21_left)

config SHIELD_LDT21_RIGHT
    def_bool $(shields_list_contains,ldt21_right)
```

## boards/shields/mew36/Kconfig.defconfig
```kconfig
if SHIELD_MEW36_LEFT

config ZMK_KEYBOARD_NAME
    default "MEW36"

config ZMK_SPLIT_ROLE_CENTRAL
    default y

endif

if SHIELD_MEW36_LEFT || SHIELD_MEW36_RIGHT

    config ZMK_SPLIT
        default y

endif
```

## boards/shields/mew36/Kconfig.shield
```kconfig
config SHIELD_MEW36_LEFT
    def_bool $(shields_list_contains,MEW36_left)

config SHIELD_MEW36_RIGHT
    def_bool $(shields_list_contains,MEW36_right)
```
